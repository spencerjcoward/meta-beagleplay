## conf/machine/beagleplay-dev-rt-k3r5.conf
```bitbake
#@TYPE: Machine
#@NAME: BeaglePlay (R5F)
#@DESCRIPTION: Machine configuration for the BeaglePlay (R5F core)

require conf/machine/include/k3r5.inc

PREFERRED_PROVIDER_virtual/bootloader = "u-boot-beagleplay-dev"
PREFERRED_PROVIDER_u-boot = "u-boot-beagleplay-dev"

SYSFW_SOC = "am62x"
SYSFW_CONFIG = "evm"
SYSFW_SUFFIX = "gp"

UBOOT_MACHINE = "am62x_beagleplay_r5_defconfig"
```

## conf/machine/beagleplay-dev.conf
```bitbake
require conf/machine/include/k3.inc

SERIAL_CONSOLES = "115200;ttyS2"

SOC_FAMILY:append = ":am62xx"

TFA_BOARD = "lite"
TFA_K3_SYSTEM_SUSPEND = "1"

OPTEEMACHINE = "k3-am62x"

UBOOT_MACHINE = "am62x_beagleplay_a53_defconfig"

PREFERRED_PROVIDER_virtual/kernel = "linux-stable"
PREFERRED_PROVIDER_virtual/bootloader = "u-boot-beagleplay-dev"
PREFERRED_PROVIDER_u-boot = "u-boot-beagleplay-dev"

KERNEL_DEVICETREE_PREFIX = " \
    ti/k3-am625 \
    ti/k3-am62x-sk \
"
KERNEL_DEVICETREE = "ti/k3-am625-beagleplay.dtb"
```

## conf/machine/beagleyai-k3r5.conf
```bitbake
#@TYPE: Machine
#@NAME: J722S EVM (R5F)
#@DESCRIPTION: Machine configuration for the TI J722S EVM (R5F core)

require conf/machine/include/k3r5.inc

PREFERRED_PROVIDER_virtual/bootloader = "u-boot-beagley-dev"
PREFERRED_PROVIDER_u-boot = "u-boot-beagley-dev"

SYSFW_SOC = "j722s"
SYSFW_CONFIG = "evm"
SYSFW_SUFFIX = "hs-fs"

UBOOT_MACHINE = "j722s_evm_r5_defconfig"
UBOOT_CONFIG_FRAGMENTS = "am67a_beagley_ai_r5.config"
```

## conf/machine/beagleyai.conf
```bitbake
#@TYPE: Machine
#@NAME: J722S EVM
#@DESCRIPTION: Machine configuration for the TI J722S EVM

require conf/machine/include/j722s.inc

PREFERRED_PROVIDER_virtual/kernel = "linux-stable"
PREFERRED_PROVIDER_virtual/bootloader = "u-boot-beagley-dev"
PREFERRED_PROVIDER_u-boot = "u-boot-beagley-dev"

KERNEL_DEVICETREE_PREFIX = " \
    ti/k3-j722s \
    ti/k3-fpdlink \
    ti/k3-v3link \
"

KERNEL_DEVICETREE = "ti/k3-am67a-beagley-ai.dtb"

UBOOT_MACHINE = "j722s_evm_a53_defconfig"
```
